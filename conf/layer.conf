## conf/layer.conf
```bitbake
# We have a conf and classes directory, add to BBPATH
BBPATH .= ":${LAYERDIR}"

# We have recipes-* directories, add to BBFILES
BBFILES += "${LAYERDIR}/recipes-*/*/*.bb \
	${LAYERDIR}/recipes-*/*/*.bbappend"

BBFILE_COLLECTIONS += "alt-install"
BBFILE_PATTERN_alt-install = "^${LAYERDIR}/"
BBFILE_PRIORITY_alt-install = "6"

LAYERSERIES_COMPAT_alt-install = "rocko thud"
```
